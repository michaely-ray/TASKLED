## main/Kconfig.projbuild
```kconfig
menu "Project Configuration"

    config PRODUCT_NAME
        string "Product Name"
        default "BlueRaven"
        help
            Name that identifies the product that is sending data.

    config FIRMWARE_MAJOR
        int "Firmware Major"
        default 0
        help
            Current MAJOR version of firmware.

    config FIRMWARE_MINOR
        int "Firmware Minor"
        default 1
        help
            Current MINOR version of firmware.

    config FIRMWARE_PATCH
        int "Firmware Patch"
        default 1
        help
            Current PATCH version of firmware.

    menu "GPRS Configuration"
        config ACTIVE_GPRS
        bool "Active GPRS connection"
        default n
        help
            Select this, the modem will send a short message before power off.
        if ACTIVE_GPRS
            choice MODEM_DEVICE
                prompt "Choose supported modem device (DCE)"
                default MODEM_DEVICE_SIM800
                help
                    Select modem device connected to the ESP DTE.
                config MODEM_DEVICE_SIM800
                    bool "SIM800"
                    help
                        SIMCom SIM800L is a GSM/GPRS module.
                        It supports Quad-band 850/900/1800/1900MHz.
                config MODEM_DEVICE_BG96
                    bool "BG96"
                    help
                        Quectel BG96 is a series of LTE Cat M1/Cat NB1/EGPRS module.
                config MODEM_DEVICE_SIM7600
                    bool "SIM7600"
                    help
                        SIM7600 is Multi-Band LTE-TDD/LTE-FDD/HSPA+ and GSM/GPRS/EDGE module
            endchoice
            config MODEM_PPP_AUTH_USERNAME
                string "Set username for authentication"
                default "vivo"
                depends on !MODEM_PPP_AUTH_NONE
                help
                    Set username for PPP Authentication.

            config MODEM_PPP_AUTH_PASSWORD
                string "Set password for authentication"
                default "vivo"
                depends on !MODEM_PPP_AUTH_NONE
                help
                    Set password for PPP Authentication.

            config MODEM_PPP_AUTH_NONE
                bool "Skip PPP authentication"
                default n
                help
                    Set to true for the PPP client to skip authentication
        endif

        menu "UART Configuration"
            config MODEM_UART_TX_PIN
                int "TXD Pin Number"
                default 25
                range 0 31
                help
                    Pin number of UART TX.

            config MODEM_UART_RX_PIN
                int "RXD Pin Number"
                default 26
                range 0 31
                help
                    Pin number of UART RX.

            config MODEM_UART_RTS_PIN
                int "RTS Pin Number"
                default 27
                range 0 31
                help
                    Pin number of UART RTS.

            config MODEM_UART_CTS_PIN
                int "CTS Pin Number"
                default 23
                range 0 31
                help
                    Pin number of UART CTS.

            config MODEM_UART_EVENT_TASK_STACK_SIZE
                int "UART Event Task Stack Size"
                range 2000 6000
                default 2048
                help
                    Stack size of UART event task.

            config MODEM_UART_EVENT_TASK_PRIORITY
                int "UART Event Task Priority"
                range 3 22
                default 5
                help
                    Priority of UART event task.

            config MODEM_UART_EVENT_QUEUE_SIZE
                int "UART Event Queue Size"
                range 10 40
                default 30
                help
                    Length of UART event queue.

            config MODEM_UART_PATTERN_QUEUE_SIZE
                int "UART Pattern Queue Size"
                range 10 40
                default 20
                help
                    Length of UART pattern queue.

            config MODEM_UART_TX_BUFFER_SIZE
                int "UART TX Buffer Size"
                range 256 2048
                default 512
                help
                    Buffer size of UART TX buffer.

            config MODEM_UART_RX_BUFFER_SIZE
                int "UART RX Buffer Size"
                range 256 2048
                default 1024
                help
                    Buffer size of UART RX buffer.
        endmenu
    endmenu

endmenu
```

## sdkconfig.defaults
```kconfig
#
# Modbus configuration
#
CONFIG_FMB_TIMER_PORT_ENABLED=y
CONFIG_FMB_TIMER_GROUP=0
CONFIG_FMB_TIMER_INDEX=0
CONFIG_FMB_MASTER_DELAY_MS_CONVERT=200
CONFIG_FMB_MASTER_TIMEOUT_MS_RESPOND=150
CONFIG_MB_UART_RXD=22
CONFIG_MB_UART_TXD=23
CONFIG_MB_UART_RTS=18
CONFIG_PARTITION_TABLE_CUSTOM=y
CONFIG_PARTITION_TABLE_CUSTOM_FILENAME="partitions_example.csv"
CONFIG_PARTITION_TABLE_FILENAME="partitions_example.csv"
CONFIG_ESPTOOLPY_FLASHSIZE_4MB=y
```
